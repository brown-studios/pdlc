## firmware/boards/brownstudios/pdlc/board.yml
```yaml
board:
  name: brownstudios_pdlc
  full_name: Brown Studios PDLC Driver
  vendor: brownstudios
  revision:
    format: major.minor.patch
    default: 2.0.0
    revisions:
      - name: 2.0.0
  socs:
    - name: stm32l151xba
```

## west.yml
```yaml
manifest:
  remotes:
    - name: zephyrproject
      url-base: https://github.com/zephyrproject-rtos
  projects:
    - name: zephyr
      repo-path: zephyr
      remote: zephyrproject
      revision: v4.3.0
      import:
        path-prefix: deps
        name-allowlist:
          - cmsis_6
          - picolibc
          - hal_stm32
  self:
    path: pdlc
```
