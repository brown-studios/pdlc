## CMakeLists.txt
```
cmake_minimum_required(VERSION 3.20.0)

set(BOARD_ROOT "${CMAKE_CURRENT_SOURCE_DIR}/..")
set(BOARD "brownstudios_pdlc")
set(BOARD_DEBUG_RUNNER openocd)
set(BOARD_FLASH_RUNNER openocd)

if(FEATURE_DEBUG)
    set(CONFIG_DEBUG y)
    set(CONFIG_DEBUG_THREAD_INFO y)
endif()

if(FEATURE_LOG)
    list(APPEND EXTRA_CONF_FILE log-deferred.conf)
    #list(APPEND EXTRA_CONF_FILE log-minimal.conf)
else()
    list(APPEND EXTRA_CONF_FILE log-none.conf)
endif()

find_package(Zephyr REQUIRED HINTS $ENV{ZEPHYR_BASE})
project(pdlc)

add_custom_command(
    OUTPUT app/include/pdlc_tables.h
    COMMAND
    ${PYTHON_EXECUTABLE}
    ${CMAKE_CURRENT_SOURCE_DIR}/../scripts/gen_pdlc_tables.py
    -o app/include/pdlc_tables.h
    DEPENDS ${CMAKE_CURRENT_SOURCE_DIR}/../scripts/gen_pdlc_tables.py
    VERBATIM
)
add_custom_target(gen_pdlc_tables DEPENDS app/include/pdlc_tables.h)
add_dependencies(app gen_pdlc_tables)

target_sources(app PRIVATE
    src/control.c
    src/main.c
    src/pdlc.c
    src/power_indicator.c
    src/status_indicator.c
)

target_include_directories(app PRIVATE
    src
    ${CMAKE_CURRENT_BINARY_DIR}/app/include
)
```

## prj.conf
```kconfig
# Configure device drivers
CONFIG_GPIO=y
CONFIG_PWM=y
CONFIG_COUNTER=y
CONFIG_DAC=y
CONFIG_WATCHDOG=y
CONFIG_WDT_DISABLE_AT_BOOT=y
CONFIG_DMA=y

# Enable link time optimization to save flash
CONFIG_LTO=y
CONFIG_ISR_TABLES_LOCAL_DECLARATION=y

# Enable I2C driver for target mode and enable interrupts
# Controller mode not used so DMA and RTIO are irrelevant
# Disabled for now to save flash space until I2C features are implemented
CONFIG_I2C=y
CONFIG_I2C_TARGET=y
CONFIG_I2C_RTIO=n
CONFIG_I2C_STM32_INTERRUPT=y
CONFIG_I2C_STM32_V2_DMA=n

# Disable unnecessary kernel features to reduce footprint
# CONFIG_POLL=n # Selected by CONFIG_SPI_ASYNC but we don't actually need it
CONFIG_ERRNO=n
CONFIG_DEVICE_DEINIT_SUPPORT=n
CONFIG_NUM_MBOX_ASYNC_MSGS=0

# Reducing the timeout resolution to 32 bits removes absolute timeout
# functions and saves about 360 bytes of flash.
CONFIG_TIMEOUT_64BIT=n

# Ensure code hygiene
CONFIG_LEGACY_GENERATED_INCLUDE_PATH=n

# Output disassembly and symbols to facilitate optimization during development
CONFIG_OUTPUT_DISASSEMBLY=y
CONFIG_OUTPUT_SYMBOLS=y
```

## log-deferred.conf
```kconfig
# Enable logging over UART with all the bells and whistles in deferred mode
CONFIG_LOG=y
CONFIG_LOG_BACKEND_UART=y
CONFIG_LOG_MODE_DEFERRED=y
CONFIG_CONSOLE=y
CONFIG_UART_CONSOLE=y
CONFIG_STDOUT_CONSOLE=n
CONFIG_PRINTK=y
CONFIG_SERIAL=y
CONFIG_TIMEOUT_64BIT=y # required for deferred tasks
```

## log-minimal.conf
```kconfig
# Enable logging over UART with minimal footprint, immediate mode, no mutual exclusion
CONFIG_LOG=y
CONFIG_LOG_MODE_MINIMAL=y
CONFIG_CONSOLE=y
CONFIG_UART_CONSOLE=y
CONFIG_STDOUT_CONSOLE=n
CONFIG_PRINTK=y
CONFIG_SERIAL=y
```

## log-none.conf
```kconfig
# Disable all logging and console features to reduce footprint
CONFIG_LOG=n
CONFIG_CONSOLE=n
CONFIG_UART_CONSOLE=n
CONFIG_STDOUT_CONSOLE=n
CONFIG_PRINTK=n
CONFIG_BOOT_BANNER=n
CONFIG_FAULT_DUMP=0
```

## dts/bindings/pwm-set.yaml
```yaml
description: |
  Holds a set of PWM child nodes so they can easily be assigned names.
  Unline pwm-leds, this binding does not instantiate LED devices.

compatible: "pwm-set"

child-binding:
  description: PWM child node
  properties:
    pwms:
      required: true
      type: phandle-array
      description: |
        Reference to a PWM instance.
```

## src/main.c
```c
#include <zephyr/drivers/gpio.h>
#include <zephyr/drivers/pwm.h>
#include <zephyr/drivers/watchdog.h>
#include <zephyr/kernel.h>
#include <zephyr/logging/log.h>

#include "control.h"
#include "pdlc.h"
#include "power_indicator.h"
#include "status_indicator.h"

LOG_MODULE_REGISTER(app);

#define WATCHDOG_TIMEOUT_MS (1000)
static const struct device *watchdog_dev = DEVICE_DT_GET(DT_NODELABEL(iwdg));

STATUS_INDICATOR_PATTERN_LOOP(status_indicator_pattern_generic_error, 0,
    STATUS_INDICATOR_PATTERN_ENTRY(STATUS_INDICATOR_HUE_RED, 2, 2, 1));

STATUS_INDICATOR_PATTERN_LOOP(status_indicator_pattern_control_error, 4,
    STATUS_INDICATOR_PATTERN_ENTRY(STATUS_INDICATOR_HUE_MAGENTA, 1, 3, STATUS_INDICATOR_PATTERN_PARAM_CYCLES));

STATUS_INDICATOR_PATTERN_LOOP(status_indicator_pattern_pdlc_error, 4,
    STATUS_INDICATOR_PATTERN_ENTRY(STATUS_INDICATOR_HUE_RED, 1, 3, STATUS_INDICATOR_PATTERN_PARAM_CYCLES));

static void show_error(int err) {
    switch (ERROR_CATEGORY(err)) {
        case ERROR_CATEGORY(CONTROL_ERROR_FIRST_):
            status_indicator_pattern(status_indicator_pattern_control_error, ERROR_INDEX(err));
            break;
        case ERROR_CATEGORY(PDLC_ERROR_FIRST_):
            status_indicator_pattern(status_indicator_pattern_pdlc_error, ERROR_INDEX(err));
            break;
        default:
            status_indicator_pattern(status_indicator_pattern_generic_error, 0);
            break;
    }
}

static void show_status(struct pdlc_status status) {
    switch (status.state) {
        case PDLC_STATE_IDLE:
            status_indicator_off();
            break;
        case PDLC_STATE_WAIT_FOR_HV_GOOD:
        case PDLC_STATE_WAIT_FOR_HV_STEADY:
        case PDLC_STATE_WAIT_FOR_OUTPUT_GOOD:
        case PDLC_STATE_WAIT_FOR_OUTPUT_STEADY:
            status_indicator_on(STATUS_INDICATOR_HUE_YELLOW);
            break;
        case PDLC_STATE_RUN:
            status_indicator_on(STATUS_INDICATOR_HUE_GREEN);
            break;
        case PDLC_STATE_HICCUP:
        case PDLC_STATE_FAULT:
            show_error(-status.error);
            break;
    }
}

static int setup(void) {
    int err;
    struct wdt_timeout_cfg watchdog_cfg = {
        .window = {
            .min = 0,
            .max = WATCHDOG_TIMEOUT_MS,
        },
        .callback = NULL,
        .flags = WDT_FLAG_RESET_SOC,
    };
    if ((err = wdt_install_timeout(watchdog_dev, &watchdog_cfg))) {
        return err;
    }
    if ((err = wdt_setup(watchdog_dev, WDT_OPT_PAUSE_HALTED_BY_DBG))) {
        return err;
    }
    if ((err = control_init())) {
        return err;
    }
    if ((err = pdlc_init())) {
        return err;
    }
    return 0;
}

static void loop(void) {
    static bool on;
    static enum control_action action_pending;
    enum control_action action = control_get_action();

    if (action != action_pending) {
        action_pending = action;
        switch (control_get_action()) {
            case CONTROL_ACTION_PRESS_MODE:
                LOG_INF("Control: CONTROL_ACTION_PRESS_MODE");
                on = !on;
                break;
            case CONTROL_ACTION_PRESS_SET:
                LOG_INF("Control: CONTROL_ACTION_PRESS_SET");
                break;
            case CONTROL_ACTION_LONG_HOLD_SET:
                LOG_INF("Control: CONTROL_ACTION_LONG_HOLD_SET");
                // todo: factory reset
                break;
            default:
                break;
        }
    }

    const unsigned scale = 256;
    const unsigned transition = 1000;
    struct pdlc_status status = pdlc_poll(on && control_get_enable() ? scale : 0, transition);
    show_status(status);
}

int main(void) {
    int err;
    if ((err = setup())) {
        status_indicator_on(STATUS_INDICATOR_HUE_RED);
        return err;
    }
    power_indicator_pulse();

    while (true) {
        if ((err = wdt_feed(watchdog_dev, 0))) {
            return err;
        }
        loop();
        k_msleep(10);
    }
    return 0;
}
```

## src/control.c
```c
#include <errno.h>
#include <zephyr/drivers/gpio.h>
#include <zephyr/kernel.h>
#include <zephyr/sys/atomic.h>

#include "control.h"

#define ZEPHYR_USER_NODE DT_PATH(zephyr_user)
static const struct gpio_dt_spec control_mode_gpio = GPIO_DT_SPEC_GET(ZEPHYR_USER_NODE, control_mode_gpios);
static const struct gpio_dt_spec control_set_gpio = GPIO_DT_SPEC_GET(ZEPHYR_USER_NODE, control_set_gpios);
static const struct gpio_dt_spec control_en_gpio = GPIO_DT_SPEC_GET(ZEPHYR_USER_NODE, control_en_gpios);

#define CONTROL_DEBOUNCE_MS (10)
#define CONTROL_LONG_HOLD_MS (10000)

static struct gpio_callback control_gpio_callback;

static atomic_t control_action_pending;
static atomic_t control_action_current;
static atomic_t control_enable_pending;
static atomic_t control_enable_current;

static void control_work_handler(struct k_work* work);
K_WORK_DELAYABLE_DEFINE(control_work, control_work_handler);

static void control_gpio_handler(const struct device *port, struct gpio_callback *cb, gpio_port_pins_t pins) {
    gpio_port_value_t value = 0;
    gpio_port_get(port, &value);
    bool control_mode = IS_BIT_SET(value, control_mode_gpio.pin);
    bool control_set = IS_BIT_SET(value, control_set_gpio.pin);
    bool control_en = IS_BIT_SET(value, control_en_gpio.pin);
    enum control_action action;
    if (control_mode && !control_set) {
        action = CONTROL_ACTION_PRESS_MODE;
    } else if (control_set && !control_mode) {
        action = CONTROL_ACTION_PRESS_SET;
    } else {
        action = CONTROL_ACTION_RELEASE;
    }
    atomic_set(&control_action_pending, action);
    atomic_set(&control_enable_pending, control_en);
    k_work_reschedule(&control_work, K_MSEC(CONTROL_DEBOUNCE_MS));
}

static void control_work_handler(struct k_work* work) {
    enum control_action action = atomic_get(&control_action_pending);
    bool reschedule_for_hold;
    switch (action) {
        case CONTROL_ACTION_PRESS_SET:
            reschedule_for_hold = atomic_cas(&control_action_pending, action, CONTROL_ACTION_LONG_HOLD_SET);
            break;
        default:
            reschedule_for_hold = false;
            break;
    }
    if (reschedule_for_hold) {
        k_work_reschedule(&control_work, K_MSEC(CONTROL_LONG_HOLD_MS));
    }

    atomic_set(&control_action_current, action);
    atomic_set(&control_enable_current, atomic_get(&control_enable_pending));
}

int control_init(void) {
    int err;
    const struct device *port = control_mode_gpio.port;
    if (port != control_set_gpio.port || port != control_en_gpio.port) {
        return -EIO;
    }
    if (!device_is_ready(port)) {
        return -ENODEV;
    }
    gpio_init_callback(&control_gpio_callback, control_gpio_handler,
        BIT(control_set_gpio.pin) | BIT(control_mode_gpio.pin) | BIT(control_en_gpio.pin));

    if ((err = gpio_pin_configure_dt(&control_mode_gpio, GPIO_INPUT)) ||
            (err = gpio_pin_configure_dt(&control_set_gpio, GPIO_INPUT)) ||
            (err = gpio_pin_configure_dt(&control_en_gpio, GPIO_INPUT))) {
        return err;
    }
    if ((err = gpio_pin_interrupt_configure_dt(&control_mode_gpio, GPIO_INT_EDGE_BOTH)) ||
            (err = gpio_pin_interrupt_configure_dt(&control_set_gpio, GPIO_INT_EDGE_BOTH)) ||
            (err = gpio_pin_interrupt_configure_dt(&control_en_gpio, GPIO_INT_EDGE_BOTH))) {
        return err;
    }
    if ((err = gpio_add_callback(port, &control_gpio_callback))) {
        return err;
    }
    return 0;
}

enum control_action control_get_action(void) {
    return atomic_get(&control_action_current);
}

bool control_get_enable(void) {
    return atomic_get(&control_enable_current);
}
```

## src/control.h
```c
/**
 * @file
 * @brief Reads the control button state.
 */

#pragma once

#include <stdint.h>

enum control_action {
    CONTROL_ACTION_RELEASE = 0,
    CONTROL_ACTION_PRESS_MODE = 1,
    CONTROL_ACTION_PRESS_SET = 2,
    CONTROL_ACTION_LONG_HOLD_SET = 3,
};

/**
 * @brief Get the action determined by the buttons.
 */
enum control_action control_get_action(void);

/**
 * @brief Get whether the output is enabled.
 */
bool control_get_enable(void);

/**
 * @brief Initialize the control driver.
 */
int control_init(void);
```

## src/errors.h
```c
/**
 * @file
 * @brief Specific error codes that describe the state of the system.
 *
 * These error codes share space with the negative errno set of values and are constrained
 * to fit into 1 byte when reported to external systems so they start at -255 and work
 * their way up.  The color of the blink error is related to the error category and the
 * index determines the number of indicator blinks for that error.
 */

#define ERROR_CATEGORY(err) (-(err) >> 3)
#define ERROR_INDEX(err) ((-(err) & 7) + 1)

// MAGENTA
#define CONTROL_ERROR_FIRST_ (-248)
#define CONTROL_ERROR_INHIBITED (CONTROL_ERROR_FIRST_)  /* Operation of the PDLC output has been remotely inhibited. */

// RED
#define PDLC_ERROR_FIRST_ (-240)
#define PDLC_ERROR_HV_TIMEOUT (PDLC_ERROR_FIRST_)          /* Boost converter did not report power good within the expected time after being enabled. */
#define PDLC_ERROR_HV_FAULT (PDLC_ERROR_FIRST_ - 1)        /* Boost converter reported power good then subsequently reported not power good. */
#define PDLC_ERROR_OUTPUT_TIMEOUT (PDLC_ERROR_FIRST_ - 2)  /* Buck converter did not report power good within the expected time after being enabled. */
#define PDLC_ERROR_OUTPUT_FAULT (PDLC_ERROR_FIRST_ - 3)    /* Buck converter reported power good then subsequently reported not power good. */
#define PDLC_ERROR_DRIVER (PDLC_ERROR_FIRST_ - 4)          /* An error occurred in the driver. */
```

## src/pdlc.c
```c
#include <errno.h>
#include <stdint.h>
#include <stdlib.h>
#include <stm32l1xx_hal.h>
#include <stm32l1xx_ll_dac.h>
#include <stm32l1xx_ll_dma.h>
#include <stm32l1xx_ll_tim.h>
#include <zephyr/cache.h>
#include <zephyr/drivers/counter.h>
#include <zephyr/drivers/dac.h>
#include <zephyr/drivers/dma.h>
#include <zephyr/drivers/gpio.h>
#include <zephyr/kernel.h>
#include <zephyr/sys/atomic.h>
#include <zephyr/logging/log.h>

#include "pdlc.h"
#include <pdlc_tables.h>

LOG_MODULE_REGISTER(pdlc);

#define ZEPHYR_USER_NODE DT_PATH(zephyr_user)

// When 1, generates the waveform but doesn't turn on the output.
#define PDLC_DEBUG_DISABLE_OUTPUT 0

// When between 0 and 256, forces the output scale factor to this value.
#define PDLC_DEBUG_FORCE_OUTPUT_SCALE -1

// When 1, waits indefinitely for HV_PG to be asserted.
#define PDLC_DEBUG_WAIT_FOR_HV_GOOD_INDEFINITELY 0

// When 1, waits indefinitely after HV_PG is asserted, prevents the output from being enabled.
#define PDLC_DEBUG_WAIT_FOR_HV_STEADY_INDEFINITELY 0

// When 1, waits indefinitely for OUTPUT_PG to be asserted.
#define PDLC_DEBUG_WAIT_FOR_OUTPUT_GOOD_INDEFINITELY 0

// When 1, waits indefinitely after OUTPUT_PG is asserted, prevents entry into the PDLC_STATE_RUN.
#define PDLC_DEBUG_WAIT_FOR_OUTPUT_STEADY_INDEFINITELY 0

/*
 * OUTPUT ELECTRICAL PARAMETERS
 */

struct pdlc_output_config {
    // The AC output frequency in Hz.
    unsigned freq;
    // The minimum DC output voltage in mV.
    unsigned voltage_min;
    // The maximum DC output voltage in mV.
    unsigned voltage_max;
};
static const struct pdlc_output_config PDLC_OUTPUT_CONFIG_DEFAULT = {
    .freq = 100,
    .voltage_min = 3000,
    .voltage_max = 60000,
};

// Calibration for the buck converters, linear DAC code to output voltage in millivolts.
#define PDLC_MIN_ADJ_CODE (0x100)
#define PDLC_MAX_ADJ_CODE (0xf00)

// Theoretical calibration
// #define PDLC_LOW_ADJ_CODE (383)
// #define PDLC_LOW_ADJ_VOLTAGE (63010)
// #define PDLC_HIGH_ADJ_CODE (3769)
// #define PDLC_HIGH_ADJ_VOLTAGE (2990)

// Actual calibration
// In these tests, phase B adj voltage was 0.008 V higher than phase A
#define PDLC_LOW_ADJ_CODE (500)
#define PDLC_LOW_ADJ_VOLTAGE (60560) // phase A: 60560, phase B: 61130
#define PDLC_HIGH_ADJ_CODE (3500)
#define PDLC_HIGH_ADJ_VOLTAGE (7730) // phase A: 7730, phase B: 7870

static inline unsigned pdlc_voltage_to_dac_code(unsigned voltage) {
    int dac_code = ((int)voltage - PDLC_HIGH_ADJ_VOLTAGE) * (PDLC_HIGH_ADJ_CODE - PDLC_LOW_ADJ_CODE) /
            (PDLC_HIGH_ADJ_VOLTAGE - PDLC_LOW_ADJ_VOLTAGE) + PDLC_HIGH_ADJ_CODE;
    return MIN(MAX(dac_code, PDLC_MIN_ADJ_CODE), PDLC_MAX_ADJ_CODE);
}

/*
 * PDLC WAVEFORM GENERATOR
 */

// Number of samples in the output waveform.
#define PDLC_HALF_WAVE_SAMPLES (PDLC_QUARTER_WAVE_SAMPLES * 2)
#define PDLC_FULL_WAVE_SAMPLES (PDLC_QUARTER_WAVE_SAMPLES * 4)

#define PDLC_WAVE_TIMER_NUMBER 6
#define PDLC_WAVE_TIMER _CONCAT(TIM, PDLC_WAVE_TIMER_NUMBER)
static const struct device *pdlc_wave_timer_dev = DEVICE_DT_GET(DT_NODELABEL(pdlc_wave_timer));

#define PDLC_DAC DAC1
static const struct device *const pdlc_dac_dev = DEVICE_DT_GET(DT_PHANDLE(ZEPHYR_USER_NODE, pdlc_dac));

#define PDLC_DMA DMA1
#define PDLC_DMA_CHANNEL (2) // DMA channel 2 serves DAC1_CH1 / TIM6
static const struct device *const pdlc_dma_dev = DEVICE_DT_GET(DT_PHANDLE(ZEPHYR_USER_NODE, pdlc_dma));

// Unsigned 24.8 bit fixed point value.
typedef uint32_t pdlc_dac_amplitude_frac;
#define PDLC_DAC_AMPLITUDE_FRAC_SHIFT (8)

struct pdlc_wave_data {
    // Guards access to the structure.
    // Functions that require holding this spinlock have the `_wl` suffix.
    struct k_spinlock lock;
    // The frequency of the waveform in Hz.
    unsigned freq;
    // True if an error occurred during DMA.
    bool dma_error;
    // The waveform's DAC DC bias level.
    unsigned dac_bias;
    // The waveform's DAC maximum amplitude at full scale.
    unsigned dac_amplitude_max;
    // The waveform's DAC peak-to-peak amplitude, expressed as a 12.8 fixed point fraction for interpolation.
    pdlc_dac_amplitude_frac dac_amplitude_frac;
    // The waveform's DAC peak-to-peak amplitude target.
    pdlc_dac_amplitude_frac dac_amplitude_frac_target;
    // The slew rate at which to increase or decrease the amplitude in code units per half electrical cycle, 0 if infinite.
    pdlc_dac_amplitude_frac dac_amplitude_frac_ramp;
    // The double-buffered output waveform, each word contains a 12-bit right aligned value for each channel.
    // Half of the waveform is updated with current scaling factors at each zero crossing when the DMA reports
    // that the transfer is half-complete or complete (and cycling back).
    uint32_t dac_samples[PDLC_FULL_WAVE_SAMPLES];
};
static struct pdlc_wave_data pdlc_wave_data;

static inline uint32_t pdlc_dac_encode(uint32_t channel_1, uint32_t channel_2) {
    return (channel_1 << 16) | channel_2;
}

// Generates a complementary pair of DAC waveforms in the first half of the buffer.
static void pdlc_wave_phase_1_wl(void) {
    const unsigned dac_bias = pdlc_wave_data.dac_bias;
    const unsigned dac_amplitude = pdlc_wave_data.dac_amplitude_frac >> PDLC_DAC_AMPLITUDE_FRAC_SHIFT;
    uint32_t * const dac_samples = pdlc_wave_data.dac_samples;
    for (unsigned i = 0; i <= PDLC_QUARTER_WAVE_SAMPLES; i++) {
        unsigned dac_level = (pdlc_quarter_wave_table[i] * dac_amplitude) >> 16;
        dac_samples[i] = pdlc_dac_encode(dac_bias + dac_level, dac_bias - dac_level);
    }
    for (unsigned i = 1; i < PDLC_QUARTER_WAVE_SAMPLES; i++) {
        dac_samples[PDLC_QUARTER_WAVE_SAMPLES + i] = dac_samples[PDLC_QUARTER_WAVE_SAMPLES - i];
    }
    sys_cache_data_flush_range(&dac_samples[0], sizeof(uint32_t) * PDLC_HALF_WAVE_SAMPLES);
}

// Generates a complementary pair of DAC waveforms in the second half of the buffer.
static void pdlc_wave_phase_2_wl(void) {
    const unsigned dac_bias = pdlc_wave_data.dac_bias;
    const unsigned dac_amplitude = pdlc_wave_data.dac_amplitude_frac >> PDLC_DAC_AMPLITUDE_FRAC_SHIFT;
    uint32_t * const dac_samples = pdlc_wave_data.dac_samples;
    for (unsigned i = 0; i <= PDLC_QUARTER_WAVE_SAMPLES; i++) {
        unsigned dac_level = (pdlc_quarter_wave_table[i] * dac_amplitude) >> 16;
        dac_samples[PDLC_HALF_WAVE_SAMPLES + i] = pdlc_dac_encode(dac_bias - dac_level, dac_bias + dac_level);
    }
    for (unsigned i = 1; i < PDLC_QUARTER_WAVE_SAMPLES; i++) {
        dac_samples[PDLC_HALF_WAVE_SAMPLES + PDLC_QUARTER_WAVE_SAMPLES + i] =
                dac_samples[PDLC_HALF_WAVE_SAMPLES + PDLC_QUARTER_WAVE_SAMPLES - i];
    }
    sys_cache_data_flush_range(&dac_samples[PDLC_HALF_WAVE_SAMPLES], sizeof(uint32_t) * PDLC_HALF_WAVE_SAMPLES);
}

// Updates the amplitude based on the ramp.
static void pdlc_wave_ramp_amplitude_wl(void) {
    if (pdlc_wave_data.dac_amplitude_frac_ramp) {
        if (pdlc_wave_data.dac_amplitude_frac < pdlc_wave_data.dac_amplitude_frac_target) {
            pdlc_wave_data.dac_amplitude_frac += MIN(pdlc_wave_data.dac_amplitude_frac_target - pdlc_wave_data.dac_amplitude_frac,
                    pdlc_wave_data.dac_amplitude_frac_ramp);
        } else if (pdlc_wave_data.dac_amplitude_frac > pdlc_wave_data.dac_amplitude_frac_target) {
            pdlc_wave_data.dac_amplitude_frac -= MIN(pdlc_wave_data.dac_amplitude_frac - pdlc_wave_data.dac_amplitude_frac_target,
                    pdlc_wave_data.dac_amplitude_frac_ramp);
        }
    } else {
        pdlc_wave_data.dac_amplitude_frac = pdlc_wave_data.dac_amplitude_frac_target;
    }
}

static void pdlc_dma_callback(const struct device *dev, void *user_data, uint32_t channel, int status) {
    K_SPINLOCK(&pdlc_wave_data.lock) {
        switch (status) {
            case DMA_STATUS_BLOCK:
                pdlc_wave_ramp_amplitude_wl();
                pdlc_wave_phase_1_wl();
                break;
            case DMA_STATUS_COMPLETE:
                pdlc_wave_ramp_amplitude_wl();
                pdlc_wave_phase_2_wl();
                break;
            default:
                pdlc_wave_data.dma_error = true;
                break;
        }
    }
}

// Writes the current bias to the DAC data holding register.
// Must only be called when the DAC trigger function is disabled.
static void pdlc_wave_write_bias_wl(void) {
    LL_DAC_ConvertDualData12RightAligned(PDLC_DAC, pdlc_wave_data.dac_bias, pdlc_wave_data.dac_bias);
    // dac_write_value(pdlc_dac_dev, 1, pdlc_wave_data.dac_bias);
    // dac_write_value(pdlc_dac_dev, 2, pdlc_wave_data.dac_bias);
}

// Starts the waveform at zero amplitude.
// Call pdlc_wave_init() beforehand to setup the parameters.
static int pdlc_wave_start(const struct pdlc_output_config *cfg) {
    const unsigned dac_at_vmax = pdlc_voltage_to_dac_code(cfg->voltage_max);
    const unsigned dac_at_vmin = pdlc_voltage_to_dac_code(cfg->voltage_min);
    const unsigned bias = (dac_at_vmax + dac_at_vmin) / 2;
    const unsigned amplitude_max = dac_at_vmin - dac_at_vmax;
    LOG_INF("pdlc_wave_start: vmax=%u, vmin=%u, dac_at_vmax=%u, dac_at_vmin=%u, bias=%u, amplitude_max=%u", cfg->voltage_max, cfg->voltage_min, dac_at_vmax, dac_at_vmin, bias, amplitude_max);

    K_SPINLOCK(&pdlc_wave_data.lock) {
        pdlc_wave_data.freq = cfg->freq;
        pdlc_wave_data.dma_error = false;
        pdlc_wave_data.dac_bias = bias;
        pdlc_wave_data.dac_amplitude_max = amplitude_max;
        pdlc_wave_data.dac_amplitude_frac = 0;
        pdlc_wave_data.dac_amplitude_frac_target = 0;
        pdlc_wave_data.dac_amplitude_frac_ramp = 0;
        for (unsigned i = 0; i < PDLC_FULL_WAVE_SAMPLES; i++) {
            pdlc_wave_data.dac_samples[i] = pdlc_dac_encode(bias, bias);
        }
        pdlc_wave_write_bias_wl();
    }

    // Enable DMA request for one DAC channel; the same request fills both channels.
    LL_DAC_EnableTrigger(PDLC_DAC, LL_DAC_CHANNEL_1);
    LL_DAC_EnableTrigger(PDLC_DAC, LL_DAC_CHANNEL_2);
    LL_DAC_EnableDMAReq(PDLC_DAC, LL_DAC_CHANNEL_1);

    int err;
    struct dma_block_config pdlc_dma_block_config = {
        .source_address = (uint32_t)pdlc_wave_data.dac_samples,
        .dest_address = (uint32_t)&PDLC_DAC->DHR12RD, // DAC dual data 12-bit right aligned holding register
        .block_size = sizeof(pdlc_wave_data.dac_samples),
        .source_addr_adj = DMA_ADDR_ADJ_INCREMENT,
        .dest_addr_adj = DMA_ADDR_ADJ_NO_CHANGE,
        .source_reload_en = true,
        .dest_reload_en = true,
    };
    struct dma_config pdlc_dma_config = {
        .channel_direction = MEMORY_TO_PERIPHERAL,
        .channel_priority = 2, // HIGH (not that it matters right now because there is no contention)
        .complete_callback_en = true,
        .source_data_size = 4,
        .dest_data_size = 4,
        .block_count = 1,
        .head_block = &pdlc_dma_block_config,
        .dma_callback = pdlc_dma_callback,
    };
    if ((err = dma_config(pdlc_dma_dev, PDLC_DMA_CHANNEL, &pdlc_dma_config))) {
        return err;
    }
    if ((err = dma_start(pdlc_dma_dev, PDLC_DMA_CHANNEL))) {
        LOG_ERR("pdlc_wave_start: dma_start error %d", err);
        return err;
    }

    struct counter_top_cfg counter_top_cfg = {
        .ticks = counter_get_frequency(pdlc_wave_timer_dev) / (cfg->freq * PDLC_FULL_WAVE_SAMPLES),
    };
    if ((err = counter_set_top_value(pdlc_wave_timer_dev, &counter_top_cfg))) {
        LOG_ERR("pdlc_wave_start: counter_set_top_value error %d", err);
        return err;
    }
    if ((err = counter_start(pdlc_wave_timer_dev))) {
        LOG_ERR("pdlc_wave_start: counter_start error %d", err);
        return err;
    }
    return 0;
}

// Stops the waveform.
static void pdlc_wave_stop(void) {
    LL_DAC_DisableDMAReq(PDLC_DAC, LL_DAC_CHANNEL_1);
    LL_DAC_DisableTrigger(PDLC_DAC, LL_DAC_CHANNEL_1);
    LL_DAC_DisableTrigger(PDLC_DAC, LL_DAC_CHANNEL_2);
    LL_DAC_ClearFlag_DMAUDR1(PDLC_DAC);

    int err;
    if ((err = counter_stop(pdlc_wave_timer_dev))) {
        LOG_ERR("pdlc_wave_stop: counter_stop error %d", err);
    }
    if ((err = dma_stop(pdlc_dma_dev, PDLC_DMA_CHANNEL))) {
        LOG_ERR("pdlc_wave_stop: dma_stop error %d", err);
    }

    K_SPINLOCK(&pdlc_wave_data.lock) {
        pdlc_wave_write_bias_wl();
    }
}

// Updates the waveform's target and retrieves the DMA status while it is running.
// Returns 0 if ready, 1 if a transition is in progress, -1 if an error occurred.
static int pdlc_wave_update(unsigned scale, unsigned transition) {
    int status;
    K_SPINLOCK(&pdlc_wave_data.lock) {
        _Static_assert(PDLC_DAC_AMPLITUDE_FRAC_SHIFT == 8, ""); // assume same as scale so no shift needed below
#if PDLC_DEBUG_FORCE_OUTPUT_SCALE >= 0 && PDLC_DEBUG_FORCE_OUTPUT_SCALE <= 256
        scale = PDLC_DEBUG_FORCE_OUTPUT_SCALE;
#endif
        pdlc_wave_data.dac_amplitude_frac_target = pdlc_wave_data.dac_amplitude_max * scale;
        pdlc_wave_data.dac_amplitude_frac_ramp = transition ?
                ((pdlc_wave_data.dac_amplitude_max * 1000) << PDLC_DAC_AMPLITUDE_FRAC_SHIFT) /
                (transition * pdlc_wave_data.freq) : 0;

        if (!pdlc_wave_data.dma_error && LL_DAC_IsActiveFlag_DMAUDR1(PDLC_DAC)) {
            // Detected a DMA underrun.
            LOG_ERR("pdlc_wave_update: DAC DMA underrun");
            pdlc_wave_data.dma_error = true;
        }
        status = pdlc_wave_data.dma_error ? -1 :
                pdlc_wave_data.dac_amplitude_frac != pdlc_wave_data.dac_amplitude_frac_target ? 1 : 0;
    }
    return status;
}

/*
 * PDLC LOOP STATE MACHINE
 */

static const struct gpio_dt_spec pdlc_hv_en_gpio = GPIO_DT_SPEC_GET(ZEPHYR_USER_NODE, pdlc_hv_en_gpios);
static const struct gpio_dt_spec pdlc_hv_pg_gpio = GPIO_DT_SPEC_GET(ZEPHYR_USER_NODE, pdlc_hv_pg_gpios);
static const struct gpio_dt_spec pdlc_output_en_gpio = GPIO_DT_SPEC_GET(ZEPHYR_USER_NODE, pdlc_output_en_gpios);
static const struct gpio_dt_spec pdlc_output_pg_a_gpio = GPIO_DT_SPEC_GET(ZEPHYR_USER_NODE, pdlc_output_pg_a_gpios);
static const struct gpio_dt_spec pdlc_output_pg_b_gpio = GPIO_DT_SPEC_GET(ZEPHYR_USER_NODE, pdlc_output_pg_b_gpios);

#define MS_TO_CYCLES(ms) (uint32_t)((uint64_t)CONFIG_SYS_CLOCK_HW_CYCLES_PER_SEC * (ms) / 1000)

// Duration to wait for HV_PG to be asserted.
#define PDLC_HV_GOOD_MS (100)
#define PDLC_HV_GOOD_CYCLES (MS_TO_CYCLES(PDLC_HV_GOOD_MS))

// Duration to wait after HV_PG has been asserted before declaring the supply is steady.
#define PDLC_HV_STEADY_MS (100)
#define PDLC_HV_STEADY_CYCLES (MS_TO_CYCLES(PDLC_HV_STEADY_MS))

// Duration to wait for PDLC_PG_A and PDLC_PG_B to be asserted.
#define PDLC_OUTPUT_GOOD_MS (100)
#define PDLC_OUTPUT_GOOD_CYCLES (MS_TO_CYCLES(PDLC_OUTPUT_GOOD_MS))

// Duration to wait after PDLC_PG_A and PDLC_PG_B have been asserted before declaring the supply is steady
// and clearing the hiccup counter.
#define PDLC_OUTPUT_STEADY_MS (2000)
#define PDLC_OUTPUT_STEADY_CYCLES (MS_TO_CYCLES(PDLC_OUTPUT_STEADY_MS))

// Duration to wait after a hiccup occurs before attempting to operate the PDLC panel again
// and the maximum number of consecutive retries before entering a fault condition.
#define PDLC_HICCUP_COOLDOWN_MS (2000)
#define PDLC_HICCUP_COOLDOWN_CYCLES (MS_TO_CYCLES(PDLC_HICCUP_COOLDOWN_MS))
#define PDLC_HICCUP_MAX_COUNT (3)

struct pdlc_loop_data {
    // Guards access to the structure.
    // Functions that require holding this spinlock have the `_ll` suffix.
    struct k_spinlock lock;
    // The state of the driver.
    enum pdlc_state state;
    // Cycle time when the driver entered the current state, used for timing wait conditions.
    uint32_t state_entry_time;
    // Error code of the most recent hiccup or fault.
    int error;
    // The number of consecutive hiccups.
    unsigned hiccup_count;
    // The output waveform configuration.
    struct pdlc_output_config output_config;
    // The output scale factor, 0 (off) to 256 (full on).
    unsigned output_scale;
    // The output transition time from off to full-on in milliseconds.
    unsigned output_transition;
};
static struct pdlc_loop_data pdlc_loop_data = {
    .output_config = PDLC_OUTPUT_CONFIG_DEFAULT,
};

static void pdlc_update_ll(void) {
#if !PDLC_DEBUG_DISABLE_OUTPUT
    const bool hv_pg = gpio_pin_get_dt(&pdlc_hv_pg_gpio);
    gpio_port_value_t pdlc_output_pg_value = 0;
    gpio_port_get(pdlc_output_pg_a_gpio.port, &pdlc_output_pg_value);
    const bool pdlc_output_pg_a = IS_BIT_SET(pdlc_output_pg_value, pdlc_output_pg_a_gpio.pin);
    const bool pdlc_output_pg_b = IS_BIT_SET(pdlc_output_pg_value, pdlc_output_pg_b_gpio.pin);
#endif
    const uint32_t cycle_time = k_cycle_get_32();
    int err;

    #define ENTER_STATE(state_) \
        pdlc_loop_data.state = state_; \
        pdlc_loop_data.state_entry_time = cycle_time; \
        LOG_INF("State: " # state_);

    #define GOTO_HICCUP(error_) \
        pdlc_loop_data.error = error_; \
        LOG_ERR("Hiccup: " # error_); \
        goto hiccup;

    if (pdlc_loop_data.output_scale) {
        if (pdlc_loop_data.state == PDLC_STATE_FAULT) {
            return; // do not operate the output until the fault is cleared
        }
        if (pdlc_loop_data.state == PDLC_STATE_HICCUP) {
            if (cycle_time - pdlc_loop_data.state_entry_time < PDLC_HICCUP_COOLDOWN_CYCLES) {
                return; // wait longer
            }
            ENTER_STATE(PDLC_STATE_IDLE);
        }
#if PDLC_DEBUG_DISABLE_OUTPUT
        if (pdlc_loop_data.state == PDLC_STATE_IDLE) {
            if ((err = pdlc_wave_start(&pdlc_loop_data.output_config))) {
                GOTO_HICCUP(PDLC_ERROR_DRIVER);
            }
            ENTER_STATE(PDLC_STATE_WAIT_FOR_OUTPUT_STEADY);
        }
#else
        if (pdlc_loop_data.state == PDLC_STATE_IDLE) {
            gpio_pin_set_dt(&pdlc_hv_en_gpio, true);
            ENTER_STATE(PDLC_STATE_WAIT_FOR_HV_GOOD);
        }
        if (pdlc_loop_data.state == PDLC_STATE_WAIT_FOR_HV_GOOD) {
            if (hv_pg) {
                ENTER_STATE(PDLC_STATE_WAIT_FOR_HV_STEADY);
            } else if (cycle_time - pdlc_loop_data.state_entry_time < PDLC_HV_GOOD_CYCLES || PDLC_DEBUG_WAIT_FOR_HV_GOOD_INDEFINITELY) {
                return; // wait longer
            } else {
                GOTO_HICCUP(PDLC_ERROR_HV_TIMEOUT);
            }
        }
        if (!hv_pg && pdlc_loop_data.state != PDLC_STATE_WAIT_FOR_OUTPUT_GOOD) {
            // Ignore HV fault while the output is being turned on because the sudden current rush
            // to charge the output capacitors can overwhelm the HV supply momentarily
            GOTO_HICCUP(PDLC_ERROR_HV_FAULT);
        }
        if (pdlc_loop_data.state == PDLC_STATE_WAIT_FOR_HV_STEADY) {
            if (cycle_time - pdlc_loop_data.state_entry_time < PDLC_HV_STEADY_CYCLES || PDLC_DEBUG_WAIT_FOR_HV_STEADY_INDEFINITELY) {
                return; // wait longer
            }
            if ((err = pdlc_wave_start(&pdlc_loop_data.output_config))) {
                GOTO_HICCUP(PDLC_ERROR_DRIVER);
            }
            gpio_pin_set_dt(&pdlc_output_en_gpio, true);
            ENTER_STATE(PDLC_STATE_WAIT_FOR_OUTPUT_GOOD);
        }
        if (pdlc_loop_data.state == PDLC_STATE_WAIT_FOR_OUTPUT_GOOD) {
            if (pdlc_output_pg_a && pdlc_output_pg_b) {
                ENTER_STATE(PDLC_STATE_WAIT_FOR_OUTPUT_STEADY);
            } else if (cycle_time - pdlc_loop_data.state_entry_time < PDLC_OUTPUT_GOOD_CYCLES || PDLC_DEBUG_WAIT_FOR_OUTPUT_GOOD_INDEFINITELY) {
                return; // wait longer
            } else {
                GOTO_HICCUP(PDLC_ERROR_OUTPUT_TIMEOUT);
            }
        }
        if (!pdlc_output_pg_a || !pdlc_output_pg_b) {
            GOTO_HICCUP(PDLC_ERROR_OUTPUT_FAULT);
        }
#endif
        if (pdlc_wave_update(pdlc_loop_data.output_scale, pdlc_loop_data.output_transition) < 0) {
            GOTO_HICCUP(PDLC_ERROR_DRIVER);
        }
        if (pdlc_loop_data.state == PDLC_STATE_WAIT_FOR_OUTPUT_STEADY) {
            if (cycle_time - pdlc_loop_data.state_entry_time < PDLC_OUTPUT_STEADY_CYCLES || PDLC_DEBUG_WAIT_FOR_OUTPUT_STEADY_INDEFINITELY) {
                return; // wait longer
            }
            ENTER_STATE(PDLC_STATE_RUN);
            pdlc_loop_data.hiccup_count = 0;
        }
        __ASSERT(pdlc_loop_data.state == PDLC_STATE_RUN, "expected PDLC run state");
        return; // everything is ok!

hiccup:
        gpio_pin_set_dt(&pdlc_output_en_gpio, false);
        gpio_pin_set_dt(&pdlc_hv_en_gpio, false);
        pdlc_wave_stop();
        ENTER_STATE(PDLC_STATE_HICCUP);
        pdlc_loop_data.hiccup_count += 1;
        if (pdlc_loop_data.hiccup_count < PDLC_HICCUP_MAX_COUNT && pdlc_loop_data.error != PDLC_ERROR_DRIVER) {
            return; // allow another retry
        }
        ENTER_STATE(PDLC_STATE_FAULT);
        return; // give up
    }

    // Output is disabled, reset state once transition is complete.
    if (pdlc_loop_data.state == PDLC_STATE_WAIT_FOR_OUTPUT_GOOD ||
            pdlc_loop_data.state == PDLC_STATE_WAIT_FOR_OUTPUT_STEADY ||
            pdlc_loop_data.state == PDLC_STATE_RUN) {
        if (hv_pg && pdlc_output_pg_a && pdlc_output_pg_b &&
                pdlc_wave_update(/*scale*/ 0, pdlc_loop_data.output_transition) > 0) {
            return ; // wait for transition to complete
        }
    }
    if (pdlc_loop_data.state != PDLC_STATE_IDLE) {
        gpio_pin_set_dt(&pdlc_output_en_gpio, false);
        gpio_pin_set_dt(&pdlc_hv_en_gpio, false);
        pdlc_wave_stop();
        ENTER_STATE(PDLC_STATE_IDLE);
        pdlc_loop_data.hiccup_count = 0;
    }
}

int pdlc_init(void) {
    int err;
    const struct device *pdlc_output_pg_port = pdlc_output_pg_a_gpio.port;
    if (pdlc_output_pg_port != pdlc_output_pg_b_gpio.port) {
        return -EIO;
    }
    if (!device_is_ready(pdlc_output_pg_port) ||
            !device_is_ready(pdlc_hv_en_gpio.port) ||
            !device_is_ready(pdlc_hv_pg_gpio.port) ||
            !device_is_ready(pdlc_output_en_gpio.port) ||
            !device_is_ready(pdlc_wave_timer_dev) ||
            !device_is_ready(pdlc_dac_dev) ||
            !device_is_ready(pdlc_dma_dev)) {
        return -ENODEV;
    }

    // Set up GPIOs.
    if ((err = gpio_pin_configure_dt(&pdlc_hv_en_gpio, GPIO_OUTPUT_INACTIVE)) ||
            (err = gpio_pin_configure_dt(&pdlc_hv_pg_gpio, GPIO_INPUT)) ||
            (err = gpio_pin_configure_dt(&pdlc_output_en_gpio, GPIO_OUTPUT_INACTIVE)) ||
            (err = gpio_pin_configure_dt(&pdlc_output_pg_a_gpio, GPIO_INPUT)) ||
            (err = gpio_pin_configure_dt(&pdlc_output_pg_b_gpio, GPIO_INPUT))) {
        return err;
    }

    // Configure the timer to trigger the DAC.
    LL_TIM_SetTriggerOutput(PDLC_WAVE_TIMER, LL_TIM_TRGO_UPDATE);

    // Configure the DAC.
    LL_DAC_SetTriggerSource(PDLC_DAC, LL_DAC_CHANNEL_1, _CONCAT(_CONCAT(LL_DAC_TRIG_EXT_TIM, PDLC_WAVE_TIMER_NUMBER), _TRGO));
    LL_DAC_SetTriggerSource(PDLC_DAC, LL_DAC_CHANNEL_2, _CONCAT(_CONCAT(LL_DAC_TRIG_EXT_TIM, PDLC_WAVE_TIMER_NUMBER), _TRGO));
    struct dac_channel_cfg dac_channel_cfg = {
        .channel_id = 1,
        .resolution = 12,
        .buffered = true,
        .internal = false,
    };
    if ((err = dac_channel_setup(pdlc_dac_dev, &dac_channel_cfg))) {
        return err;
    }
    dac_channel_cfg.channel_id = 2;
    if ((err = dac_channel_setup(pdlc_dac_dev, &dac_channel_cfg))) {
        return err;
    }
    return 0;
}

struct pdlc_status pdlc_poll(unsigned scale, unsigned transition) {
    struct pdlc_status status = {};
    K_SPINLOCK(&pdlc_loop_data.lock) {
        //pdlc_loop_data.output_config = PDLC_OUTPUT_CONFIG_DEFAULT;
        pdlc_loop_data.output_scale = scale;
        pdlc_loop_data.output_transition = transition;
        pdlc_update_ll();

        status.state = pdlc_loop_data.state;
        status.error = -pdlc_loop_data.error;
        status.hiccup_count = pdlc_loop_data.hiccup_count;
    }
    return status;
}
```

## src/pdlc.h
```c
/**
 * @file
 * @brief PDLC panel driver.
 */

#pragma once

#include <stdint.h>

#include "errors.h"

int pdlc_init(void);

enum pdlc_state {
    // The driver is off.
    PDLC_STATE_IDLE = 0,
    // The driver is turning on, waiting for the HV_PG signal to be asserted.
    PDLC_STATE_WAIT_FOR_HV_GOOD = 1,
    // The driver is turning on, waiting for the HV_PG signal to remain asserted for a sufficient duration.
    PDLC_STATE_WAIT_FOR_HV_STEADY = 2,
    // The driver is turning on, waiting for PDLC_PG_A and PDLC_PG_B signals to be asserted.
    PDLC_STATE_WAIT_FOR_OUTPUT_GOOD = 3,
    // The driver is on, waiting for the PDLC_PG_A and PDLC_PG_B signal to remain asserted for a sufficient duration.
    PDLC_STATE_WAIT_FOR_OUTPUT_STEADY = 4,
    // The driver is on and the output appears steady so the hiccup counter has been reset.
    PDLC_STATE_RUN = 5,
    // The driver is off because it encountered a transient problem and will retry after a cooldown period expires.
    PDLC_STATE_HICCUP = 6,
    // The driver is off because it encountered a durable problem and will not try again until the output is reset.
    PDLC_STATE_FAULT = 7,
};

// PDLC driver status.
struct __packed pdlc_status {
    // PDLC driver state.
    enum pdlc_state state : 4;
    // Error code of the most recent hiccup or fault (negated to make the constant positive).
    unsigned error : 8;
    // Number of consecutive hiccups.
    unsigned hiccup_count : 4;
    unsigned : 16;
};
_Static_assert(sizeof(struct pdlc_status) == 4, "");

/**
 * @brief Update the PDLC driver state.  Must be called at least once every 10 ms.
 * 
 * @param scale Set to 0 to disable the high voltage supply and turn off the PDLC output.
 * Set to 256 to enable the high voltage supply and output at maximum amplitude or use a
 * value between 0 and 256 to scale the output amplitude proportionally.
 * @param transition Time in milliseconds to ramp the voltage from zero to full scale.
 * @return The status of the driver.
 */
struct pdlc_status pdlc_poll(unsigned scale, unsigned transition);
```

## src/power_indicator.c
```c
#include <zephyr/drivers/pwm.h>
#include <zephyr/kernel.h>

#include "power_indicator.h"

static const struct pwm_dt_spec power_pwm = PWM_DT_SPEC_GET_BY_IDX(DT_NODELABEL(power_indicator), 0);

static void power_indicator_handler(struct k_work* work);
K_WORK_DELAYABLE_DEFINE(power_indicator_work, power_indicator_handler);

#define POWER_INDICATOR_TIMEOUT_MS (10000)

// Brightness scale factors: 0 (off), 64 (full bright)
#define POWER_INDICATOR_SCALE (32)
#define POWER_INDICATOR_SCALE_BITS (6)

static void power_indicator_handler(struct k_work* work) {
    pwm_set_pulse_dt(&power_pwm, 0);
}

void power_indicator_pulse(void) {
    pwm_set_pulse_dt(&power_pwm, (power_pwm.period * POWER_INDICATOR_SCALE) >> POWER_INDICATOR_SCALE_BITS);
    k_work_reschedule(&power_indicator_work, K_MSEC(POWER_INDICATOR_TIMEOUT_MS));
}
```

## src/power_indicator.h
```c
/**
 * @file
 * @brief Sets the power indicator state.
 */

#pragma once

/**
 * @brief Turn the indicator on briefly.
 */
void power_indicator_pulse(void);
```

## src/status_indicator.c
```c
/**
 * @file Component to indicate status with color and flashing patterns.
 */

#include <zephyr/drivers/pwm.h>
#include <zephyr/kernel.h>

#include "status_indicator.h"

static const struct pwm_dt_spec red_pwm = PWM_DT_SPEC_GET_BY_IDX(DT_NODELABEL(status_indicator_red), 0);
static const struct pwm_dt_spec green_pwm = PWM_DT_SPEC_GET_BY_IDX(DT_NODELABEL(status_indicator_green), 0);
static const struct pwm_dt_spec blue_pwm = PWM_DT_SPEC_GET_BY_IDX(DT_NODELABEL(status_indicator_blue), 0);

K_SEM_DEFINE(status_indicator_sem, 1, 1);

static const status_indicator_pattern_t *status_indicator_pattern_current;
static unsigned status_indicator_pattern_index;
static unsigned status_indicator_pattern_cycle;
static unsigned status_indicator_pattern_param;
static bool status_indicator_pattern_on;

static void status_indicator_pattern_handler(struct k_work* work);
K_WORK_DELAYABLE_DEFINE(status_indicator_pattern_work, status_indicator_pattern_handler);

// Brightness scale factors: 0 (off), 64 (full bright)
#define STATUS_INDICATOR_RED_SCALE (20)
#define STATUS_INDICATOR_GREEN_SCALE (8)
#define STATUS_INDICATOR_BLUE_SCALE (12)
#define STATUS_INDICATOR_SCALE_BITS (6)

static void status_indicator_pwm_set_off_l() {
    pwm_set_pulse_dt(&red_pwm, 0);
    pwm_set_pulse_dt(&green_pwm, 0);
    pwm_set_pulse_dt(&blue_pwm, 0);
}

static void status_indicator_pwm_set_on_l(unsigned hue) {
    unsigned r, g, b;
    hue = ((hue & 0xffff) * 1536 + 0x8000) >> 16;
    if (hue < 512) {
        if (hue < 256) {
            g = hue;
            r = 256;
        } else {
            r = 512 - hue;
            g = 256;
        }
        b = 0;
    } else if (hue < 1024) {
        if (hue < 768) {
            b = hue - 512;
            g = 256;
        } else {
            g = 1024 - hue;
            b = 256;
        }
        r = 0;
    } else {
        if (hue < 1280) {
            r = hue - 1024;
            b = 256;
        } else {
            b = 1536 - hue;
            r = 256;
        }
        g = 0;
    }

    pwm_set_pulse_dt(&red_pwm, (((r * red_pwm.period) >> 8) * STATUS_INDICATOR_RED_SCALE) >> STATUS_INDICATOR_SCALE_BITS);
    pwm_set_pulse_dt(&green_pwm, (((g * green_pwm.period) >> 8) * STATUS_INDICATOR_GREEN_SCALE) >> STATUS_INDICATOR_SCALE_BITS);
    pwm_set_pulse_dt(&blue_pwm, (((b * blue_pwm.period) >> 8) * STATUS_INDICATOR_BLUE_SCALE) >> STATUS_INDICATOR_SCALE_BITS);
}

static void status_indicator_pattern_advance_l(void) {
    for (;;) {
        const struct status_indicator_pattern_entry *entry = &status_indicator_pattern_current[status_indicator_pattern_index];
        if (!status_indicator_pattern_on) {
            if (entry->cycles) {
                status_indicator_pattern_on = true;
                status_indicator_pwm_set_on_l(entry->hue);
                k_work_reschedule(&status_indicator_pattern_work, K_MSEC(entry->on_time * 100));
                break; // wait for next cycle
            }
            if (entry->on_time) {
                break; // end pattern
            }
            status_indicator_pattern_index = 0; // repeat pattern
            status_indicator_pattern_cycle = 0;
            if (entry->off_time) {
                k_work_reschedule(&status_indicator_pattern_work, K_MSEC(entry->off_time * 100));
                break; // wait for delay between repetitions
            }
        } else {
            status_indicator_pattern_cycle += 1;
            unsigned cycles = (entry->cycles == STATUS_INDICATOR_PATTERN_PARAM_CYCLES ? status_indicator_pattern_param : entry->cycles);
            if (status_indicator_pattern_cycle >= cycles) {
                status_indicator_pattern_index += 1;
                status_indicator_pattern_cycle = 0;
            }
            status_indicator_pattern_on = false;
            if (entry->off_time) {
                status_indicator_pwm_set_off_l();
                k_work_reschedule(&status_indicator_pattern_work, K_MSEC(entry->off_time * 100));
                break; // wait for next cycle
            }
        }
    }
}

static void status_indicator_pattern_handler(struct k_work* work) {
    k_sem_take(&status_indicator_sem, K_FOREVER);
    if (status_indicator_pattern_current) {
        status_indicator_pattern_advance_l();
    } else if (status_indicator_pattern_on) {
        status_indicator_pwm_set_off_l();
    }
    k_sem_give(&status_indicator_sem);
}

void status_indicator_off(void) {
    k_sem_take(&status_indicator_sem, K_FOREVER);
    status_indicator_pattern_current = NULL;
    status_indicator_pattern_on = false;
    status_indicator_pwm_set_off_l();
    k_sem_give(&status_indicator_sem);
}

void status_indicator_on(unsigned hue) {
    k_sem_take(&status_indicator_sem, K_FOREVER);
    status_indicator_pattern_current = NULL;
    status_indicator_pattern_on = false;
    status_indicator_pwm_set_on_l(hue);
    k_sem_give(&status_indicator_sem);
}

void status_indicator_pattern(const status_indicator_pattern_t *pattern, unsigned param) {
    k_sem_take(&status_indicator_sem, K_FOREVER);
    if (status_indicator_pattern_current != pattern || status_indicator_pattern_param != param) {
        status_indicator_pattern_current = pattern;
        status_indicator_pattern_param = param;
        if (pattern) {
            status_indicator_pattern_index = 0;
            status_indicator_pattern_cycle = 0;
            status_indicator_pattern_on = false;
            status_indicator_pattern_advance_l();
        }
    } else if (!status_indicator_pattern_on) {
        status_indicator_pwm_set_off_l();
    }
    k_sem_give(&status_indicator_sem);
}
```

## src/status_indicator.h
```c
/**
 * @file
 * @brief Sets the status indicator color.
 */

#pragma once

#include <stdint.h>

#define STATUS_INDICATOR_HUE_RED (0)
#define STATUS_INDICATOR_HUE_AMBER (5462)
#define STATUS_INDICATOR_HUE_YELLOW (10923)
#define STATUS_INDICATOR_HUE_GREEN (21845)
#define STATUS_INDICATOR_HUE_CYAN (32768)
#define STATUS_INDICATOR_HUE_BLUE (43691)
#define STATUS_INDICATOR_HUE_MAGENTA (54613)

/**
 * @brief Turn the indicator off.
 */
void status_indicator_off(void);

/**
 * @brief Turn the indicator on.
 *
 * @param hue Color hue in a range from 0 to 65536, cycles every 65536.
 */
void status_indicator_on(unsigned hue);

/**
 * @brief Defines a pattern of colors for an indicator.
 *
 * The indicator turns on with the given hue for on_time then off for off_time blinking up to cycle times.
 * The time intervals are specified in 0.1 second increments.
 * Terminate an array of pattern entries with an entry with cycles = 0.
 * If the last entry has zero on_time then the pattern repeats after off_time interval, otherwise it stops.
 * If the value of cycles is STATUS_INDICATOR_PATTERN_PARAM_CYCLES then the pattern parameter determines the count.
 */
struct status_indicator_pattern_entry {
    unsigned hue : 16;
    unsigned on_time : 5;
    unsigned off_time : 5;
    unsigned cycles : 6;
};
_Static_assert(sizeof(struct status_indicator_pattern_entry) == 4, "");
typedef struct status_indicator_pattern_entry status_indicator_pattern_t;

#define STATUS_INDICATOR_PATTERN_PARAM_CYCLES (0x3f)
#define STATUS_INDICATOR_PATTERN_ENTRY(hue_, on_time_, off_time_, cycles_) { .hue = hue_, .on_time = on_time_, .off_time = off_time_, .cycles = cycles_ }
#define STATUS_INDICATOR_PATTERN_ENTRY_REPEAT(delay_) STATUS_INDICATOR_PATTERN_ENTRY(0, 0, delay_, 0)
#define STATUS_INDICATOR_PATTERN_ENTRY_END STATUS_INDICATOR_PATTERN_ENTRY(0, 1, 0, 0)
#define STATUS_INDICATOR_PATTERN_ONCE(name, ...) static const status_indicator_pattern_t name[] = { __VA_ARGS__, STATUS_INDICATOR_PATTERN_ENTRY_END }
#define STATUS_INDICATOR_PATTERN_LOOP(name, delay_, ...) static const status_indicator_pattern_t name[] = { __VA_ARGS__, STATUS_INDICATOR_PATTERN_ENTRY_REPEAT(delay_) }

/**
 * @brief Perform an indicator pattern.
 *
 * The pattern remains active until status_indicator_on or status_indicator_off are called.
 * Calling this function repeatedly with the same pattern does not restart it.
 *
 * @param pattern Pattern to perform, or NULL to stop the pattern at the end
 * its current on-time cycle or turn the indicator off immediately if no pattern
 * is running.
 * @param param Parameter value for STATUS_INDICATOR_PATTERN_PARAM_CYCLES, 0 if unused.
 */
void status_indicator_pattern(const status_indicator_pattern_t *pattern, unsigned cycles);
```
